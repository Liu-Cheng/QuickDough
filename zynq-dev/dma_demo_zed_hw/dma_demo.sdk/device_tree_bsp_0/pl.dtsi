/*
 * CAUTION: This file is automatically generated by Xilinx.
 * Version:  
 * Today is: Tue Sep  6 16:14:26 2016
*/


/ {
	amba_pl: amba_pl {
		#address-cells = <1>;
		#size-cells = <1>;
		compatible = "simple-bus";
		ranges ;
		acc_ip_0: acc_ip@43c10000 {
			compatible = "xlnx,acc-ip-1.0";
			interrupt-parent = <&intc>;
			interrupts = <0 30 1>;
			reg = <0x43c10000 0x10000>;
			xlnx,s00-axi-addr-width = <0x4>;
			xlnx,s00-axi-data-width = <0x20>;
		};
		usr_dma_0: usr_dma@43c00000 {
			compatible = "xlnx,usr-dma-1.0";
			interrupt-parent = <&intc>;
			interrupts = <0 29 4>;
			reg = <0x43c00000 0x10000>;
		};
	};
};
